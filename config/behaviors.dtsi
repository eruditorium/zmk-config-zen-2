/ behaviors {
        // For the "layer" key, it'd nice to be able to use it as either a shift or a toggle.
        // Configure it as a tap dance, so the first tap (or hold) is a &mo and the second tap is a &to

        hm: homerow_mods {
            compatible = "zmk,behavior-hold-tap";
            #binding-cells = <2>;
            tapping-term-ms = <170>;
            flavor = "tap-preferred";
            quick-tap-ms = <0>;
            require-prior-idle-ms = <125>;
            bindings = <&kp>, <&kp>;
        };

        shm: shift_hr_mod {
            compatible = "zmk,behavior-hold-tap";
            #binding-cells = <2>;
            tapping-term-ms = <150>;
            flavor = "tap-preferred";
            quick-tap-ms = <0>;
            require-prior-idle-ms = <125>;
            bindings = <&kp>, <&kp>;
        };
    };
	
