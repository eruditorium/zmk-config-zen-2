/ { 
	macros {
        selectline: selectline {
            compatible = "zmk,behavior-macro";
            #binding-cells = <0>;
            bindings = <&kp HOME &kp LS(END)>;
            label = "SELECTLINE";
        };

        selectword: selectword {
            compatible = "zmk,behavior-macro";
            #binding-cells = <0>;
            bindings = <&kp LC(RIGHT) &kp LC(LEFT) &kp LS(LC(RIGHT))>;
            label = "SELECTWORD";
        };
    };
};